## conf/layer.conf
```bitbake
BBPATH .= ":${LAYERDIR}"
BBFILES += "${LAYERDIR}/recipes-*/*/*.bb \
             ${LAYERDIR}/recipes-*/*/*.bbappend"

BBFILE_COLLECTIONS += "iot-gateway"
BBFILE_PATTERN_iot-gateway = "^${LAYERDIR}/"
BBFILE_PRIORITY_iot-gateway = "10"

LAYERDEPENDS_iot-gateway = "core meta-raspberrypi"
LAYERSERIES_COMPAT_iot-gateway = "kirkstone"
```
